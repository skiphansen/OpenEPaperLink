#include <stddef.h>
#include "asmUtil.h"
#include "screen.h"
#include "printf.h"
#include "cpu.h"
#include "timer.h"
#include "sleep.h"
#include "board.h"
#include "powermgt.h"
#include "adc.h"
#include "settings.h"
#include "logging.h"

// uc8151 like commands
#define CMD_PANEL_SETTING 0x00
#define CMD_POWER_SETTING 0x01
#define CMD_POWER_OFF 0x02
#define CMD_POWER_OFF_SEQUENCE 0x03
#define CMD_POWER_ON 0x04
#define CMD_POWER_ON_MEASURE 0x05
#define CMD_BOOSTER_SOFT_START 0x06
#define CMD_DEEP_SLEEP 0x07
#define CMD_DISPLAY_START_TRANSMISSION_DTM1 0x10
#define CMD_DATA_STOP 0x11
#define CMD_DISPLAY_REFRESH 0x12
#define CMD_IPC 0x13
#define CMD_PLL_CONTROL 0x30
#define CMD_TEMPERATURE_CALIB 0x40
#define CMD_TEMPERATURE_SELECT 0x41
#define CMD_TEMPERATURE_WRITE 0x42
#define CMD_TEMPERATURE_READ 0x43
#define CMD_VCOM_INTERVAL 0x50
#define CMD_LOWER_POWER_DETECT 0x51
#define CMD_TCON_SETTING 0x60
#define CMD_RESOLUTION_SETTING 0x61
#define CMD_REVISION 0x70
#define CMD_STATUS 0x71
#define CMD_AUTO_MEASUREMENT_VCOM 0x80
#define CMD_READ_VCOM 0x81
#define CMD_VCOM_DC_SETTING 0x82
#define CMD_PARTIAL_WINDOW 0x90
#define CMD_PARTIAL_IN 0x91
#define CMD_PARTIAL_OUT 0x92
#define CMD_PROGRAM_MODE 0xA0
#define CMD_ACTIVE_PROGRAM 0xA1
#define CMD_READ_OTP 0xA2
#define CMD_CASCADE_SET 0xE0
#define CMD_POWER_SAVING 0xE3
#define CMD_FORCE_TEMPERATURE 0xE5

uint8_t __xdata mScreenVcom;

/*
   //eInk pinout:
   // pin  1 = MFCSB    = ? optional
   // pin  8 = BS1      = P0.0
   // pin  9 = BUSY     = P1.0
   // pin 10 = nRESET      = P1.2
   // pin 11 = D/nC     = P0.7
   // pin 12 = nCS      = P1.1
   // pin 13 = D0(SCK)  = P1.3
   // pin 14 = D1(SDIN) = P1.5 (also can be data out)
   // pin 19 = FMSDO    = ?   optional
   //extra pins
   // nEnable           = P0.6
   
   
   //controller is 99.9% likely to be UC8159 version c_B
   
   //LUT format info from: https://www.buydisplay.com/download/ic/UC8159C.pdf


      VCOM LUT is: 20x VcomLutInfo
      
         VcomLutInfo {
            u8 numRepeats;    //how many times to perform this LUT step
            u2 level[8];      //MSB to LSB. 00 = VCM_DC, 01 = 15V + VCM_DC, 10 = -15V + VCM_DC, 11 = float
            u8 numFrames[8];  //for each level
         }


      COLOR LUTs ARE: 20x ColorLutInfo
      
         ColorLutInfo {
            u8 numRepeats;    //how many times to perform this LUT step
            u4 level[8];      //MSB to LSB. top bit ignored. 000 = VCM_DC, 001 = 15V (VSH), 010 = -15V (VSL), 011 = VSH_LV, 100 = VSL_LV, 101 = VSH_LVX, 110 = VSL_LVX, 111 = float
            u8 numFrames[8];  //for each level
         }
      
      
      XON LUT is: 20x XonLutInfo
      
         XonLutInfo {
            u8 numRepeats;    //how many times to perform this LUT step
            u1 level[8];      //MSB to LSB. 0 = all gates ON, 1 = normal gate scan
            u8 numFrames[8];  //for each level
         }
*/

__xdata __at (0xfda2) uint8_t gTempBuf320[320];  //350 bytes here, we use 320 of them

struct LutCorrectionRange {   //all possible ranges must be covered
   int8_t minTemp;         //inclusive
   int8_t maxTemp;         //inclusive
   uint8_t vals[4];     
};

struct LutCorrectionEntry {
   uint16_t offset;     //0xffff for end of list
   uint8_t len;         //up to 4
   const struct LutCorrectionRange __code *ranges;
};

__bit gScreenPowered = false;

#define LUT_CMD_000  0x21
#define LUT_CMD_001  0x23
#define LUT_CMD_010  0x24
#define LUT_CMD_011  0x22
#define LUT_CMD_100  0x25
#define LUT_CMD_101  0x26
#define LUT_CMD_110  0x27
#define LUT_CMD_111  0x28

#ifdef DMITRY_LUT
#define SET_LUT(_idx, _nm, _len, _corrections)  screenPrvSendLut(_idx, _nm, sizeof(_nm), _len, false, _corrections);
#define SET_COLOR_LUT(_idx, _nm, _corrections)  SET_LUT(LUT_CMD_ ## _idx, _nm, 260, _corrections);
#define SET_XON_LUT(_nm)                  screenPrvSendLut(0x29, _nm, sizeof(_nm), 200, true, 0);

extern int LinkError(void);
#define VERIFY_SUM8(_v1, _v2, _v3, _v4, _v5, _v6, _v7, _v8, _sum) (_v1), (_v2), (_v3), (_v4), (_v5), (_v6), (_v7), (_v8) + (((_v1) + (_v2) + (_v3) + (_v4) + (_v5) + (_v6) + (_v7) + (_v8) != (_sum)) ? LinkError() : 0)
#if BUILD == chroma74y
#define NUM_REPS_INITIAL_CHILL      1
#define NUM_FRMS_INITIAL_CHILL      0xc8

#define NUM_REPS_DC_BALANCE         1
#define NUM_FRMS_DC_BALANCE         9

#define NUM_REPS_ACTIVATE_1         29
#define NUM_FRMS_ACTIVATE_1         19

#define NUM_REPS_ACTIVATE_SLOW      16
#define NUM_FRMS_ACTIVATE_SLOW      0x98

#define NUM_REPS_ACTIVATE_FAST      50
#define NUM_FRMS_ACTIVATE_FAST      12

#define NUM_REPS_ACTIVATE_MED    5
#define NUM_FRMS_ACTIVATE_MED    20

#define NUM_REPS_COARSE_GREYS    22
#define NUM_FRMS_COARSE_GREYS    8

#define NUM_REPS_DEVELOP_YELLOWS_1  6
#define NUM_FRMS_DEVELOP_YELLOWS_1  0x58

#define NUM_REPS_DEVELOP_Y2_n_G     5        //becomes 4 for temp <= 18
#define NUM_FRMS_DEVELOP_Y2_n_G     0x7d

#define NUM_REPS_LET_IT_SETTLE      2
#define NUM_FRMS_LET_IT_SETTLE      0x50

static const uint8_t __code mLutVcom[] = {
   NUM_REPS_INITIAL_CHILL,    0x00, 0x00, VERIFY_SUM8(0x64, 0x64, 0x00, 0x00, 0x00, 0x00, 0x00, 0x00, NUM_FRMS_INITIAL_CHILL),
   NUM_REPS_DC_BALANCE,    0x00, 0x00, VERIFY_SUM8(0x01, 0x01, 0x07, 0x00, 0x00, 0x00, 0x00, 0x00, NUM_FRMS_DC_BALANCE),
   NUM_REPS_ACTIVATE_1,    0x00, 0x00, VERIFY_SUM8(0x03, 0x01, 0x03, 0x05, 0x07, 0x00, 0x00, 0x00, NUM_FRMS_ACTIVATE_1),
   NUM_REPS_ACTIVATE_SLOW,    0x00, 0x00, VERIFY_SUM8(0x4C, 0x4C, 0x00, 0x00, 0x00, 0x00, 0x00, 0x00, NUM_FRMS_ACTIVATE_SLOW),
   NUM_REPS_ACTIVATE_FAST,    0x00, 0x00, VERIFY_SUM8(0x06, 0x06, 0x00, 0x00, 0x00, 0x00, 0x00, 0x00, NUM_FRMS_ACTIVATE_FAST),
   NUM_REPS_ACTIVATE_MED,     0x00, 0x00, VERIFY_SUM8(0x0A, 0x0A, 0x00, 0x00, 0x00, 0x00, 0x00, 0x00, NUM_FRMS_ACTIVATE_MED),
   NUM_REPS_COARSE_GREYS,     0x00, 0x00, VERIFY_SUM8(0x02, 0x02, 0x04, 0x00, 0x00, 0x00, 0x00, 0x00, NUM_FRMS_COARSE_GREYS),
   NUM_REPS_DEVELOP_YELLOWS_1,   0x00, 0x00, VERIFY_SUM8(0x50, 0x01, 0x07, 0x00, 0x00, 0x00, 0x00, 0x00, NUM_FRMS_DEVELOP_YELLOWS_1),
   NUM_REPS_DEVELOP_Y2_n_G,   0x00, 0x00, VERIFY_SUM8(0x50, 0x28, 0x05, 0x00, 0x00, 0x00, 0x00, 0x00, NUM_FRMS_DEVELOP_Y2_n_G),
   NUM_REPS_LET_IT_SETTLE,    0x00, 0x00, VERIFY_SUM8(0x50, 0x00, 0x00, 0x00, 0x00, 0x00, 0x00, 0x00, NUM_FRMS_LET_IT_SETTLE),
};

#define ACTIVATION_COMMON                                                                                         \
   NUM_REPS_ACTIVATE_SLOW,    0x41, 0x20, 0x00, 0x00, VERIFY_SUM8(0x20, 0x3C, 0x3C, 0x00, 0x00, 0x00, 0x00, 0x00, NUM_FRMS_ACTIVATE_SLOW),   \
   NUM_REPS_ACTIVATE_FAST,    0x12, 0x00, 0x00, 0x00, VERIFY_SUM8(0x06, 0x06, 0x00, 0x00, 0x00, 0x00, 0x00, 0x00, NUM_FRMS_ACTIVATE_FAST),   \
   NUM_REPS_ACTIVATE_MED,     0x12, 0x00, 0x00, 0x00, VERIFY_SUM8(0x0A, 0x0A, 0x00, 0x00, 0x00, 0x00, 0x00, 0x00, NUM_FRMS_ACTIVATE_MED),


static const uint8_t __code mLutB[] = {
   NUM_REPS_INITIAL_CHILL,    0x42, 0x00, 0x00, 0x00, VERIFY_SUM8(0x94, 0x34, 0x00, 0x00, 0x00, 0x00, 0x00, 0x00, NUM_FRMS_INITIAL_CHILL),
   NUM_REPS_DC_BALANCE,    0x01, 0x20, 0x00, 0x00, VERIFY_SUM8(0x01, 0x01, 0x07, 0x00, 0x00, 0x00, 0x00, 0x00, NUM_FRMS_DC_BALANCE),
   NUM_REPS_ACTIVATE_1,    0x11, 0x02, 0x20, 0x00, VERIFY_SUM8(0x03, 0x01, 0x03, 0x05, 0x07, 0x00, 0x00, 0x00, NUM_FRMS_ACTIVATE_1),
   ACTIVATION_COMMON
   NUM_REPS_COARSE_GREYS,     0x01, 0x10, 0x00, 0x00, VERIFY_SUM8(0x02, 0x02, 0x04, 0x00, 0x00, 0x00, 0x00, 0x00, NUM_FRMS_COARSE_GREYS),
   NUM_REPS_DEVELOP_YELLOWS_1,   0x42, 0x00, 0x00, 0x00, VERIFY_SUM8(0x50, 0x08, 0x00, 0x00, 0x00, 0x00, 0x00, 0x00, NUM_FRMS_DEVELOP_YELLOWS_1),
   NUM_REPS_DEVELOP_Y2_n_G,   0x42, 0x10, 0x10, 0x10, VERIFY_SUM8(0x2d, 0x1a, 0x0c, 0x06, 0x0c, 0x06, 0x0c, 0x06, NUM_FRMS_DEVELOP_Y2_n_G),
   NUM_REPS_LET_IT_SETTLE,    0x00, 0x00, 0x00, 0x00, VERIFY_SUM8(0x40, 0x10, 0x00, 0x00, 0x00, 0x00, 0x00, 0x00, NUM_FRMS_LET_IT_SETTLE),
};

static const uint8_t __code mLutG0[] = {
   NUM_REPS_INITIAL_CHILL,    0x42, 0x00, 0x00, 0x00, VERIFY_SUM8(0x94, 0x34, 0x00, 0x00, 0x00, 0x00, 0x00, 0x00, NUM_FRMS_INITIAL_CHILL),
   NUM_REPS_DC_BALANCE,    0x01, 0x10, 0x00, 0x00, VERIFY_SUM8(0x01, 0x01, 0x07, 0x00, 0x00, 0x00, 0x00, 0x00, NUM_FRMS_DC_BALANCE),
   NUM_REPS_ACTIVATE_1,    0x11, 0x20, 0x20, 0x00, VERIFY_SUM8(0x03, 0x01, 0x03, 0x05, 0x07, 0x00, 0x00, 0x00, NUM_FRMS_ACTIVATE_1),
   ACTIVATION_COMMON
   NUM_REPS_COARSE_GREYS,     0x00, 0x00, 0x00, 0x00, VERIFY_SUM8(0x02, 0x02, 0x04, 0x00, 0x00, 0x00, 0x00, 0x00, NUM_FRMS_COARSE_GREYS),
   NUM_REPS_DEVELOP_YELLOWS_1,   0x42, 0x00, 0x00, 0x00, VERIFY_SUM8(0x50, 0x08, 0x00, 0x00, 0x00, 0x00, 0x00, 0x00, NUM_FRMS_DEVELOP_YELLOWS_1),
   NUM_REPS_DEVELOP_Y2_n_G,   0x42, 0x10, 0x10, 0x10, VERIFY_SUM8(0x2d, 0x1a, 0x08, 0x0a, 0x08, 0x0a, 0x08, 0x0a, NUM_FRMS_DEVELOP_Y2_n_G),
   NUM_REPS_LET_IT_SETTLE,    0x00, 0x00, 0x00, 0x00, VERIFY_SUM8(0x40, 0x10, 0x00, 0x00, 0x00, 0x00, 0x00, 0x00, NUM_FRMS_LET_IT_SETTLE),
};

static const uint8_t __code mLutG1[] = {
   NUM_REPS_INITIAL_CHILL,    0x42, 0x00, 0x00, 0x00, VERIFY_SUM8(0x94, 0x34, 0x00, 0x00, 0x00, 0x00, 0x00, 0x00, NUM_FRMS_INITIAL_CHILL),
   NUM_REPS_DC_BALANCE,    0x01, 0x10, 0x00, 0x00, VERIFY_SUM8(0x01, 0x01, 0x07, 0x00, 0x00, 0x00, 0x00, 0x00, NUM_FRMS_DC_BALANCE),
   NUM_REPS_ACTIVATE_1,    0x11, 0x20, 0x20, 0x00, VERIFY_SUM8(0x03, 0x01, 0x03, 0x05, 0x07, 0x00, 0x00, 0x00, NUM_FRMS_ACTIVATE_1),
   ACTIVATION_COMMON
   NUM_REPS_COARSE_GREYS,     0x00, 0x00, 0x00, 0x00, VERIFY_SUM8(0x02, 0x02, 0x04, 0x00, 0x00, 0x00, 0x00, 0x00, NUM_FRMS_COARSE_GREYS),
   NUM_REPS_DEVELOP_YELLOWS_1,   0x42, 0x00, 0x00, 0x00, VERIFY_SUM8(0x50, 0x08, 0x00, 0x00, 0x00, 0x00, 0x00, 0x00, NUM_FRMS_DEVELOP_YELLOWS_1),
   NUM_REPS_DEVELOP_Y2_n_G,   0x42, 0x10, 0x10, 0x10, VERIFY_SUM8(0x2d, 0x1a, 0x06, 0x0c, 0x06, 0x0c, 0x06, 0x0c, NUM_FRMS_DEVELOP_Y2_n_G),
   NUM_REPS_LET_IT_SETTLE,    0x00, 0x00, 0x00, 0x00, VERIFY_SUM8(0x40, 0x10, 0x00, 0x00, 0x00, 0x00, 0x00, 0x00, NUM_FRMS_LET_IT_SETTLE),
};

static const uint8_t __code mLutG2[] = {
   NUM_REPS_INITIAL_CHILL,    0x42, 0x00, 0x00, 0x00, VERIFY_SUM8(0x94, 0x34, 0x00, 0x00, 0x00, 0x00, 0x00, 0x00, NUM_FRMS_INITIAL_CHILL),
   NUM_REPS_DC_BALANCE,    0x01, 0x10, 0x00, 0x00, VERIFY_SUM8(0x01, 0x01, 0x07, 0x00, 0x00, 0x00, 0x00, 0x00, NUM_FRMS_DC_BALANCE),
   NUM_REPS_ACTIVATE_1,    0x11, 0x20, 0x20, 0x00, VERIFY_SUM8(0x03, 0x01, 0x03, 0x05, 0x07, 0x00, 0x00, 0x00, NUM_FRMS_ACTIVATE_1),
   ACTIVATION_COMMON
   NUM_REPS_COARSE_GREYS,     0x00, 0x00, 0x00, 0x00, VERIFY_SUM8(0x02, 0x02, 0x04, 0x00, 0x00, 0x00, 0x00, 0x00, NUM_FRMS_COARSE_GREYS),
   NUM_REPS_DEVELOP_YELLOWS_1,   0x42, 0x00, 0x00, 0x00, VERIFY_SUM8(0x50, 0x08, 0x00, 0x00, 0x00, 0x00, 0x00, 0x00, NUM_FRMS_DEVELOP_YELLOWS_1),
   NUM_REPS_DEVELOP_Y2_n_G,   0x42, 0x10, 0x10, 0x10, VERIFY_SUM8(0x2d, 0x1a, 0x05, 0x0d, 0x05, 0x0d, 0x05, 0x0d, NUM_FRMS_DEVELOP_Y2_n_G),
   NUM_REPS_LET_IT_SETTLE,    0x00, 0x00, 0x00, 0x00, VERIFY_SUM8(0x40, 0x10, 0x00, 0x00, 0x00, 0x00, 0x00, 0x00, NUM_FRMS_LET_IT_SETTLE),
};

static const uint8_t __code mLutG3[] = {
   NUM_REPS_INITIAL_CHILL,    0x42, 0x00, 0x00, 0x00, VERIFY_SUM8(0x94, 0x34, 0x00, 0x00, 0x00, 0x00, 0x00, 0x00, NUM_FRMS_INITIAL_CHILL),
   NUM_REPS_DC_BALANCE,    0x01, 0x10, 0x00, 0x00, VERIFY_SUM8(0x01, 0x01, 0x07, 0x00, 0x00, 0x00, 0x00, 0x00, NUM_FRMS_DC_BALANCE),
   NUM_REPS_ACTIVATE_1,    0x11, 0x20, 0x20, 0x00, VERIFY_SUM8(0x03, 0x01, 0x03, 0x05, 0x07, 0x00, 0x00, 0x00, NUM_FRMS_ACTIVATE_1),
   ACTIVATION_COMMON
   NUM_REPS_COARSE_GREYS,     0x00, 0x00, 0x00, 0x00, VERIFY_SUM8(0x02, 0x02, 0x04, 0x00, 0x00, 0x00, 0x00, 0x00, NUM_FRMS_COARSE_GREYS),
   NUM_REPS_DEVELOP_YELLOWS_1,   0x42, 0x00, 0x00, 0x00, VERIFY_SUM8(0x50, 0x08, 0x00, 0x00, 0x00, 0x00, 0x00, 0x00, NUM_FRMS_DEVELOP_YELLOWS_1),
   NUM_REPS_DEVELOP_Y2_n_G,   0x42, 0x10, 0x10, 0x10, VERIFY_SUM8(0x2d, 0x1a, 0x04, 0x0e, 0x04, 0x0e, 0x04, 0x0e, NUM_FRMS_DEVELOP_Y2_n_G),
   NUM_REPS_LET_IT_SETTLE,    0x00, 0x00, 0x00, 0x00, VERIFY_SUM8(0x40, 0x10, 0x00, 0x00, 0x00, 0x00, 0x00, 0x00, NUM_FRMS_LET_IT_SETTLE),
};

static const uint8_t __code mLutG4[] = {
   NUM_REPS_INITIAL_CHILL,    0x42, 0x00, 0x00, 0x00, VERIFY_SUM8(0x94, 0x34, 0x00, 0x00, 0x00, 0x00, 0x00, 0x00, NUM_FRMS_INITIAL_CHILL),
   NUM_REPS_DC_BALANCE,    0x01, 0x10, 0x00, 0x00, VERIFY_SUM8(0x01, 0x01, 0x07, 0x00, 0x00, 0x00, 0x00, 0x00, NUM_FRMS_DC_BALANCE),
   NUM_REPS_ACTIVATE_1,    0x11, 0x20, 0x20, 0x00, VERIFY_SUM8(0x03, 0x01, 0x03, 0x05, 0x07, 0x00, 0x00, 0x00, NUM_FRMS_ACTIVATE_1),
   ACTIVATION_COMMON
   NUM_REPS_COARSE_GREYS,     0x00, 0x00, 0x00, 0x00, VERIFY_SUM8(0x02, 0x02, 0x04, 0x00, 0x00, 0x00, 0x00, 0x00, NUM_FRMS_COARSE_GREYS),
   NUM_REPS_DEVELOP_YELLOWS_1,   0x42, 0x00, 0x00, 0x00, VERIFY_SUM8(0x50, 0x08, 0x00, 0x00, 0x00, 0x00, 0x00, 0x00, NUM_FRMS_DEVELOP_YELLOWS_1),
   NUM_REPS_DEVELOP_Y2_n_G,   0x42, 0x10, 0x10, 0x10, VERIFY_SUM8(0x2d, 0x1a, 0x02, 0x10, 0x02, 0x10, 0x03, 0x0f, NUM_FRMS_DEVELOP_Y2_n_G),
   NUM_REPS_LET_IT_SETTLE,    0x00, 0x00, 0x00, 0x00, VERIFY_SUM8(0x40, 0x10, 0x00, 0x00, 0x00, 0x00, 0x00, 0x00, NUM_FRMS_LET_IT_SETTLE),
};

static const uint8_t __code mLutW[] = {
   NUM_REPS_INITIAL_CHILL,    0x42, 0x00, 0x00, 0x00, VERIFY_SUM8(0x94, 0x34, 0x00, 0x00, 0x00, 0x00, 0x00, 0x00, NUM_FRMS_INITIAL_CHILL),
   NUM_REPS_DC_BALANCE,    0x01, 0x10, 0x00, 0x00, VERIFY_SUM8(0x01, 0x01, 0x07, 0x00, 0x00, 0x00, 0x00, 0x00, NUM_FRMS_DC_BALANCE),
   NUM_REPS_ACTIVATE_1,    0x11, 0x12, 0x00, 0x00, VERIFY_SUM8(0x03, 0x01, 0x03, 0x05, 0x07, 0x00, 0x00, 0x00, NUM_FRMS_ACTIVATE_1),
   ACTIVATION_COMMON
   NUM_REPS_COARSE_GREYS,     0x20, 0x00, 0x00, 0x00, VERIFY_SUM8(0x02, 0x02, 0x04, 0x00, 0x00, 0x00, 0x00, 0x00, NUM_FRMS_COARSE_GREYS),
   NUM_REPS_DEVELOP_YELLOWS_1,   0x42, 0x00, 0x00, 0x00, VERIFY_SUM8(0x50, 0x08, 0x00, 0x00, 0x00, 0x00, 0x00, 0x00, NUM_FRMS_DEVELOP_YELLOWS_1),
   NUM_REPS_DEVELOP_Y2_n_G,   0x00, 0x00, 0x00, 0x00, VERIFY_SUM8(0x50, 0x2a, 0x03, 0x00, 0x00, 0x00, 0x00, 0x00, NUM_FRMS_DEVELOP_Y2_n_G),
   NUM_REPS_LET_IT_SETTLE,    0x00, 0x00, 0x00, 0x00, VERIFY_SUM8(0x40, 0x10, 0x00, 0x00, 0x00, 0x00, 0x00, 0x00, NUM_FRMS_LET_IT_SETTLE),
};

static const uint8_t __code mLutBrightYellow[] = {
   NUM_REPS_INITIAL_CHILL,    0x42, 0x00, 0x00, 0x00, VERIFY_SUM8(0x94, 0x34, 0x00, 0x00, 0x00, 0x00, 0x00, 0x00, NUM_FRMS_INITIAL_CHILL),
   NUM_REPS_DC_BALANCE,    0x00, 0x20, 0x00, 0x00, VERIFY_SUM8(0x01, 0x01, 0x07, 0x00, 0x00, 0x00, 0x00, 0x00, NUM_FRMS_DC_BALANCE),
   NUM_REPS_ACTIVATE_1,    0x11, 0x02, 0x20, 0x00, VERIFY_SUM8(0x03, 0x01, 0x03, 0x05, 0x07, 0x00, 0x00, 0x00, NUM_FRMS_ACTIVATE_1),
   ACTIVATION_COMMON
   NUM_REPS_COARSE_GREYS,     0x03, 0x30, 0x00, 0x00, VERIFY_SUM8(0x02, 0x02, 0x04, 0x00, 0x00, 0x00, 0x00, 0x00, NUM_FRMS_COARSE_GREYS),
   NUM_REPS_DEVELOP_YELLOWS_1,   0x30, 0x20, 0x00, 0x00, VERIFY_SUM8(0x50, 0x01, 0x07, 0x00, 0x00, 0x00, 0x00, 0x00, NUM_FRMS_DEVELOP_YELLOWS_1),
   NUM_REPS_DEVELOP_Y2_n_G,   0x30, 0x20, 0x00, 0x00, VERIFY_SUM8(0x50, 0x28, 0x05, 0x00, 0x00, 0x00, 0x00, 0x00, NUM_FRMS_DEVELOP_Y2_n_G),
   NUM_REPS_LET_IT_SETTLE,    0x00, 0x00, 0x00, 0x00, VERIFY_SUM8(0x40, 0x10, 0x00, 0x00, 0x00, 0x00, 0x00, 0x00, NUM_FRMS_LET_IT_SETTLE),
};

static const uint8_t __code mLutXon[] = 
{
   NUM_REPS_INITIAL_CHILL,    0xFF, VERIFY_SUM8(0x64, 0x64, 0x00, 0x00, 0x00, 0x00, 0x00, 0x00, NUM_FRMS_INITIAL_CHILL),
   NUM_REPS_DC_BALANCE,    0xFF, VERIFY_SUM8(0x01, 0x01, 0x07, 0x00, 0x00, 0x00, 0x00, 0x00, NUM_FRMS_DC_BALANCE),
   NUM_REPS_ACTIVATE_1,    0xFF, VERIFY_SUM8(0x03, 0x01, 0x03, 0x05, 0x07, 0x00, 0x00, 0x00, NUM_FRMS_ACTIVATE_1),
   NUM_REPS_ACTIVATE_SLOW,    0xFF, VERIFY_SUM8(0x4C, 0x4C, 0x00, 0x00, 0x00, 0x00, 0x00, 0x00, NUM_FRMS_ACTIVATE_SLOW),
   NUM_REPS_ACTIVATE_FAST,    0xFF, VERIFY_SUM8(0x06, 0x06, 0x00, 0x00, 0x00, 0x00, 0x00, 0x00, NUM_FRMS_ACTIVATE_FAST),
   NUM_REPS_ACTIVATE_MED,     0xFF, VERIFY_SUM8(0x0A, 0x0A, 0x00, 0x00, 0x00, 0x00, 0x00, 0x00, NUM_FRMS_ACTIVATE_MED),
   NUM_REPS_COARSE_GREYS,     0xFF, VERIFY_SUM8(0x02, 0x02, 0x04, 0x00, 0x00, 0x00, 0x00, 0x00, NUM_FRMS_COARSE_GREYS),
   NUM_REPS_DEVELOP_YELLOWS_1,   0xFF, VERIFY_SUM8(0x50, 0x01, 0x07, 0x00, 0x00, 0x00, 0x00, 0x00, NUM_FRMS_DEVELOP_YELLOWS_1),
   NUM_REPS_DEVELOP_Y2_n_G,   0xFF, VERIFY_SUM8(0x50, 0x28, 0x05, 0x00, 0x00, 0x00, 0x00, 0x00, NUM_FRMS_DEVELOP_Y2_n_G),
   NUM_REPS_LET_IT_SETTLE,    0xFF, VERIFY_SUM8(0x40, 0x10, 0x00, 0x00, 0x00, 0x00, 0x00, 0x00, NUM_FRMS_LET_IT_SETTLE),
};

#elif BUILD == chroma74r
// Lookup tables for black white red display
#define VERIFY_SUM8(_v1, _v2, _v3, _v4, _v5, _v6, _v7, _v8, _sum) (_v1), (_v2), (_v3), (_v4), (_v5), (_v6), (_v7), (_v8) + (((_v1) + (_v2) + (_v3) + (_v4) + (_v5) + (_v6) + (_v7) + (_v8) != (_sum)) ? LinkError() : 0)

#define NUM_REPS_INITIAL_CHILL      1
#define NUM_FRMS_INITIAL_CHILL      0xc8

#define NUM_REPS_DC_BALANCE         1
#define NUM_FRMS_DC_BALANCE         9

#define NUM_REPS_ACTIVATE_1         29
#define NUM_FRMS_ACTIVATE_1         19

#define NUM_REPS_ACTIVATE_SLOW      16
#define NUM_FRMS_ACTIVATE_SLOW      0x98

#define NUM_REPS_ACTIVATE_FAST      50
#define NUM_FRMS_ACTIVATE_FAST      12

#define NUM_REPS_ACTIVATE_MED    5
#define NUM_FRMS_ACTIVATE_MED    20

#define NUM_REPS_DEVELOP_Y1_n_G     30
#define NUM_FRMS_DEVELOP_Y1_n_G     0x80

#define NUM_REPS_DEVELOP_Y2_n_G     4
#define NUM_FRMS_DEVELOP_Y2_n_G     0x10

#define NUM_REPS_LET_IT_SETTLE      15
#define NUM_FRMS_LET_IT_SETTLE      0x50

static const uint8_t __code mLutVcom[] = {
   NUM_REPS_INITIAL_CHILL,    0x00, 0x00, VERIFY_SUM8(0x64, 0x64, 0x00, 0x00, 0x00, 0x00, 0x00, 0x00, NUM_FRMS_INITIAL_CHILL),
   NUM_REPS_DC_BALANCE,    0x00, 0x00, VERIFY_SUM8(0x01, 0x01, 0x07, 0x00, 0x00, 0x00, 0x00, 0x00, NUM_FRMS_DC_BALANCE),
   NUM_REPS_ACTIVATE_1,    0x00, 0x00, VERIFY_SUM8(0x03, 0x01, 0x03, 0x05, 0x07, 0x00, 0x00, 0x00, NUM_FRMS_ACTIVATE_1),
   NUM_REPS_ACTIVATE_SLOW,    0x00, 0x00, VERIFY_SUM8(0x4C, 0x4C, 0x00, 0x00, 0x00, 0x00, 0x00, 0x00, NUM_FRMS_ACTIVATE_SLOW),
   NUM_REPS_ACTIVATE_FAST,    0x00, 0x00, VERIFY_SUM8(0x06, 0x06, 0x00, 0x00, 0x00, 0x00, 0x00, 0x00, NUM_FRMS_ACTIVATE_FAST),
   NUM_REPS_ACTIVATE_MED,     0x00, 0x00, VERIFY_SUM8(0x0A, 0x0A, 0x00, 0x00, 0x00, 0x00, 0x00, 0x00, NUM_FRMS_ACTIVATE_MED),
   NUM_REPS_DEVELOP_Y1_n_G,   0x00, 0x00, VERIFY_SUM8(0x50, 0x28, 0x08, 0x00, 0x00, 0x00, 0x00, 0x00, NUM_FRMS_DEVELOP_Y1_n_G),
   NUM_REPS_DEVELOP_Y2_n_G,   0x00, 0x00, VERIFY_SUM8(0x10, 0x00, 0x00, 0x00, 0x00, 0x00, 0x00, 0x00, NUM_FRMS_DEVELOP_Y2_n_G),
   NUM_REPS_LET_IT_SETTLE,    0x00, 0x00, VERIFY_SUM8(0x50, 0x00, 0x00, 0x00, 0x00, 0x00, 0x00, 0x00, NUM_FRMS_LET_IT_SETTLE),
};

#define ACTIVATION_COMMON                                                                                         \
   NUM_REPS_ACTIVATE_SLOW,    0x41, 0x20, 0x00, 0x00, VERIFY_SUM8(0x20, 0x3C, 0x3C, 0x00, 0x00, 0x00, 0x00, 0x00, NUM_FRMS_ACTIVATE_SLOW),   \
   NUM_REPS_ACTIVATE_FAST,    0x12, 0x00, 0x00, 0x00, VERIFY_SUM8(0x06, 0x06, 0x00, 0x00, 0x00, 0x00, 0x00, 0x00, NUM_FRMS_ACTIVATE_FAST),   \
   NUM_REPS_ACTIVATE_MED,     0x12, 0x00, 0x00, 0x00, VERIFY_SUM8(0x0A, 0x0A, 0x00, 0x00, 0x00, 0x00, 0x00, 0x00, NUM_FRMS_ACTIVATE_MED),


static const uint8_t __code mLutB[] = {
   NUM_REPS_INITIAL_CHILL,    0x42, 0x00, 0x00, 0x00, VERIFY_SUM8(0x94, 0x34, 0x00, 0x00, 0x00, 0x00, 0x00, 0x00, NUM_FRMS_INITIAL_CHILL),
   NUM_REPS_DC_BALANCE,    0x01, 0x20, 0x00, 0x00, VERIFY_SUM8(0x01, 0x01, 0x07, 0x00, 0x00, 0x00, 0x00, 0x00, NUM_FRMS_DC_BALANCE),
   NUM_REPS_ACTIVATE_1,    0x11, 0x02, 0x20, 0x00, VERIFY_SUM8(0x03, 0x01, 0x03, 0x05, 0x07, 0x00, 0x00, 0x00, NUM_FRMS_ACTIVATE_1),
   ACTIVATION_COMMON
   NUM_REPS_DEVELOP_Y1_n_G,   0x41, 0x01, 0x01, 0x01, VERIFY_SUM8(0x41, 0x0f, 0x01, 0x0f, 0x01, 0x0f, 0x01, 0x0f, NUM_FRMS_DEVELOP_Y1_n_G),
   NUM_REPS_DEVELOP_Y2_n_G,   0x10, 0x00, 0x00, 0x00, VERIFY_SUM8(0x05, 0x0b, 0x00, 0x00, 0x00, 0x00, 0x00, 0x00, NUM_FRMS_DEVELOP_Y2_n_G),
   NUM_REPS_LET_IT_SETTLE,    0x00, 0x00, 0x00, 0x00, VERIFY_SUM8(0x40, 0x10, 0x00, 0x00, 0x00, 0x00, 0x00, 0x00, NUM_FRMS_LET_IT_SETTLE),
};

static const uint8_t __code mLutG0[] = {
   NUM_REPS_INITIAL_CHILL,    0x42, 0x00, 0x00, 0x00, VERIFY_SUM8(0x94, 0x34, 0x00, 0x00, 0x00, 0x00, 0x00, 0x00, NUM_FRMS_INITIAL_CHILL),
   NUM_REPS_DC_BALANCE,    0x01, 0x20, 0x00, 0x00, VERIFY_SUM8(0x01, 0x01, 0x07, 0x00, 0x00, 0x00, 0x00, 0x00, NUM_FRMS_DC_BALANCE),
   NUM_REPS_ACTIVATE_1,    0x11, 0x20, 0x20, 0x00, VERIFY_SUM8(0x03, 0x01, 0x03, 0x05, 0x07, 0x00, 0x00, 0x00, NUM_FRMS_ACTIVATE_1),
   ACTIVATION_COMMON
   NUM_REPS_DEVELOP_Y1_n_G,   0x41, 0x01, 0x01, 0x01, VERIFY_SUM8(0x41, 0x0f, 0x01, 0x0f, 0x01, 0x0f, 0x01, 0x0f, NUM_FRMS_DEVELOP_Y1_n_G),
   NUM_REPS_DEVELOP_Y2_n_G,   0x24, 0x00, 0x00, 0x00, VERIFY_SUM8(0x01, 0x07, 0x08, 0x00, 0x00, 0x00, 0x00, 0x00, NUM_FRMS_DEVELOP_Y2_n_G),
   NUM_REPS_LET_IT_SETTLE,    0x00, 0x00, 0x00, 0x00, VERIFY_SUM8(0x40, 0x10, 0x00, 0x00, 0x00, 0x00, 0x00, 0x00, NUM_FRMS_LET_IT_SETTLE),
};

static const uint8_t __code mLutG1[] = {
   NUM_REPS_INITIAL_CHILL,    0x42, 0x00, 0x00, 0x00, VERIFY_SUM8(0x94, 0x34, 0x00, 0x00, 0x00, 0x00, 0x00, 0x00, NUM_FRMS_INITIAL_CHILL),
   NUM_REPS_DC_BALANCE,    0x01, 0x20, 0x00, 0x00, VERIFY_SUM8(0x01, 0x01, 0x07, 0x00, 0x00, 0x00, 0x00, 0x00, NUM_FRMS_DC_BALANCE),
   NUM_REPS_ACTIVATE_1,    0x11, 0x20, 0x20, 0x00, VERIFY_SUM8(0x03, 0x01, 0x03, 0x05, 0x07, 0x00, 0x00, 0x00, NUM_FRMS_ACTIVATE_1),
   ACTIVATION_COMMON
   NUM_REPS_DEVELOP_Y1_n_G,   0x41, 0x01, 0x01, 0x01, VERIFY_SUM8(0x41, 0x0f, 0x01, 0x0f, 0x01, 0x0f, 0x01, 0x0f, NUM_FRMS_DEVELOP_Y1_n_G),
   NUM_REPS_DEVELOP_Y2_n_G,   0x24, 0x00, 0x00, 0x00, VERIFY_SUM8(0x02, 0x06, 0x08, 0x00, 0x00, 0x00, 0x00, 0x00, NUM_FRMS_DEVELOP_Y2_n_G),
   NUM_REPS_LET_IT_SETTLE,    0x00, 0x00, 0x00, 0x00, VERIFY_SUM8(0x40, 0x10, 0x00, 0x00, 0x00, 0x00, 0x00, 0x00, NUM_FRMS_LET_IT_SETTLE),
};

static const uint8_t __code mLutG2[] = {
   NUM_REPS_INITIAL_CHILL,    0x42, 0x00, 0x00, 0x00, VERIFY_SUM8(0x94, 0x34, 0x00, 0x00, 0x00, 0x00, 0x00, 0x00, NUM_FRMS_INITIAL_CHILL),
   NUM_REPS_DC_BALANCE,    0x01, 0x20, 0x00, 0x00, VERIFY_SUM8(0x01, 0x01, 0x07, 0x00, 0x00, 0x00, 0x00, 0x00, NUM_FRMS_DC_BALANCE),
   NUM_REPS_ACTIVATE_1,    0x11, 0x20, 0x20, 0x00, VERIFY_SUM8(0x03, 0x01, 0x03, 0x05, 0x07, 0x00, 0x00, 0x00, NUM_FRMS_ACTIVATE_1),
   ACTIVATION_COMMON
   NUM_REPS_DEVELOP_Y1_n_G,   0x41, 0x01, 0x01, 0x01, VERIFY_SUM8(0x41, 0x0f, 0x01, 0x0f, 0x01, 0x0f, 0x01, 0x0f, NUM_FRMS_DEVELOP_Y1_n_G),
   NUM_REPS_DEVELOP_Y2_n_G,   0x24, 0x00, 0x00, 0x00, VERIFY_SUM8(0x03, 0x05, 0x08, 0x00, 0x00, 0x00, 0x00, 0x00, NUM_FRMS_DEVELOP_Y2_n_G),
   NUM_REPS_LET_IT_SETTLE,    0x00, 0x00, 0x00, 0x00, VERIFY_SUM8(0x40, 0x10, 0x00, 0x00, 0x00, 0x00, 0x00, 0x00, NUM_FRMS_LET_IT_SETTLE),
};

static const uint8_t __code mLutG3[] = {
   NUM_REPS_INITIAL_CHILL,    0x42, 0x00, 0x00, 0x00, VERIFY_SUM8(0x94, 0x34, 0x00, 0x00, 0x00, 0x00, 0x00, 0x00, NUM_FRMS_INITIAL_CHILL),
   NUM_REPS_DC_BALANCE,    0x01, 0x20, 0x00, 0x00, VERIFY_SUM8(0x01, 0x01, 0x07, 0x00, 0x00, 0x00, 0x00, 0x00, NUM_FRMS_DC_BALANCE),
   NUM_REPS_ACTIVATE_1,    0x11, 0x20, 0x20, 0x00, VERIFY_SUM8(0x03, 0x01, 0x03, 0x05, 0x07, 0x00, 0x00, 0x00, NUM_FRMS_ACTIVATE_1),
   ACTIVATION_COMMON
   NUM_REPS_DEVELOP_Y1_n_G,   0x41, 0x01, 0x01, 0x01, VERIFY_SUM8(0x41, 0x0f, 0x01, 0x0f, 0x01, 0x0f, 0x01, 0x0f, NUM_FRMS_DEVELOP_Y1_n_G),
   NUM_REPS_DEVELOP_Y2_n_G,   0x24, 0x00, 0x00, 0x00, VERIFY_SUM8(0x04, 0x04, 0x08, 0x00, 0x00, 0x00, 0x00, 0x00, NUM_FRMS_DEVELOP_Y2_n_G),
   NUM_REPS_LET_IT_SETTLE,    0x00, 0x00, 0x00, 0x00, VERIFY_SUM8(0x40, 0x10, 0x00, 0x00, 0x00, 0x00, 0x00, 0x00, NUM_FRMS_LET_IT_SETTLE),
};

static const uint8_t __code mLutG4[] = {
   NUM_REPS_INITIAL_CHILL,    0x42, 0x00, 0x00, 0x00, VERIFY_SUM8(0x94, 0x34, 0x00, 0x00, 0x00, 0x00, 0x00, 0x00, NUM_FRMS_INITIAL_CHILL),
   NUM_REPS_DC_BALANCE,    0x01, 0x20, 0x00, 0x00, VERIFY_SUM8(0x01, 0x01, 0x07, 0x00, 0x00, 0x00, 0x00, 0x00, NUM_FRMS_DC_BALANCE),
   NUM_REPS_ACTIVATE_1,    0x11, 0x20, 0x20, 0x00, VERIFY_SUM8(0x03, 0x01, 0x03, 0x05, 0x07, 0x00, 0x00, 0x00, NUM_FRMS_ACTIVATE_1),
   ACTIVATION_COMMON
   NUM_REPS_DEVELOP_Y1_n_G,   0x41, 0x01, 0x01, 0x01, VERIFY_SUM8(0x41, 0x0f, 0x01, 0x0f, 0x01, 0x0f, 0x01, 0x0f, NUM_FRMS_DEVELOP_Y1_n_G),
   NUM_REPS_DEVELOP_Y2_n_G,   0x24, 0x00, 0x00, 0x00, VERIFY_SUM8(0x05, 0x03, 0x08, 0x00, 0x00, 0x00, 0x00, 0x00, NUM_FRMS_DEVELOP_Y2_n_G),
   NUM_REPS_LET_IT_SETTLE,    0x00, 0x00, 0x00, 0x00, VERIFY_SUM8(0x40, 0x10, 0x00, 0x00, 0x00, 0x00, 0x00, 0x00, NUM_FRMS_LET_IT_SETTLE),
};

static const uint8_t __code mLutW[] = {
   NUM_REPS_INITIAL_CHILL,    0x42, 0x00, 0x00, 0x00, VERIFY_SUM8(0x94, 0x34, 0x00, 0x00, 0x00, 0x00, 0x00, 0x00, NUM_FRMS_INITIAL_CHILL),
   NUM_REPS_DC_BALANCE,    0x01, 0x10, 0x00, 0x00, VERIFY_SUM8(0x01, 0x01, 0x07, 0x00, 0x00, 0x00, 0x00, 0x00, NUM_FRMS_DC_BALANCE),
   NUM_REPS_ACTIVATE_1,    0x11, 0x12, 0x00, 0x00, VERIFY_SUM8(0x03, 0x01, 0x03, 0x05, 0x07, 0x00, 0x00, 0x00, NUM_FRMS_ACTIVATE_1),
   ACTIVATION_COMMON
   NUM_REPS_DEVELOP_Y1_n_G,   0x41, 0x01, 0x01, 0x01, VERIFY_SUM8(0x41, 0x0f, 0x01, 0x0f, 0x01, 0x0f, 0x01, 0x0f, NUM_FRMS_DEVELOP_Y1_n_G),
   NUM_REPS_DEVELOP_Y2_n_G,   0x24, 0x24, 0x00, 0x00, VERIFY_SUM8(0x06, 0x02, 0x06, 0x02, 0x00, 0x00, 0x00, 0x00, NUM_FRMS_DEVELOP_Y2_n_G),
   NUM_REPS_LET_IT_SETTLE,    0x00, 0x00, 0x00, 0x00, VERIFY_SUM8(0x40, 0x10, 0x00, 0x00, 0x00, 0x00, 0x00, 0x00, NUM_FRMS_LET_IT_SETTLE),
};

static const uint8_t __code mLutBrightRed[] = {
   NUM_REPS_INITIAL_CHILL,    0x42, 0x00, 0x00, 0x00, VERIFY_SUM8(0x94, 0x34, 0x00, 0x00, 0x00, 0x00, 0x00, 0x00, NUM_FRMS_INITIAL_CHILL),
   NUM_REPS_DC_BALANCE,    0x01, 0x20, 0x00, 0x00, VERIFY_SUM8(0x01, 0x01, 0x07, 0x00, 0x00, 0x00, 0x00, 0x00, NUM_FRMS_DC_BALANCE),
   NUM_REPS_ACTIVATE_1,    0x11, 0x02, 0x20, 0x00, VERIFY_SUM8(0x03, 0x01, 0x03, 0x05, 0x07, 0x00, 0x00, 0x00, NUM_FRMS_ACTIVATE_1),
   ACTIVATION_COMMON
   NUM_REPS_DEVELOP_Y1_n_G,   0x23, 0x00, 0x00, 0x00, VERIFY_SUM8(0x10, 0x70, 0x00, 0x00, 0x00, 0x00, 0x00, 0x00, NUM_FRMS_DEVELOP_Y1_n_G),
   NUM_REPS_DEVELOP_Y2_n_G,   0x30, 0x00, 0x00, 0x00, VERIFY_SUM8(0x10, 0x00, 0x00, 0x00, 0x00, 0x00, 0x00, 0x00, NUM_FRMS_DEVELOP_Y2_n_G),
   NUM_REPS_LET_IT_SETTLE,    0x00, 0x00, 0x00, 0x00, VERIFY_SUM8(0x40, 0x10, 0x00, 0x00, 0x00, 0x00, 0x00, 0x00, NUM_FRMS_LET_IT_SETTLE),
};

static const uint8_t __code mLutXon[] = {
   NUM_REPS_INITIAL_CHILL,    0xFF, VERIFY_SUM8(0x64, 0x64, 0x00, 0x00, 0x00, 0x00, 0x00, 0x00, NUM_FRMS_INITIAL_CHILL),
   NUM_REPS_DC_BALANCE,    0xFF, VERIFY_SUM8(0x01, 0x01, 0x07, 0x00, 0x00, 0x00, 0x00, 0x00, NUM_FRMS_DC_BALANCE),
   NUM_REPS_ACTIVATE_1,    0xFF, VERIFY_SUM8(0x03, 0x01, 0x03, 0x05, 0x07, 0x00, 0x00, 0x00, NUM_FRMS_ACTIVATE_1),
   NUM_REPS_ACTIVATE_SLOW,    0xFF, VERIFY_SUM8(0x4C, 0x4C, 0x00, 0x00, 0x00, 0x00, 0x00, 0x00, NUM_FRMS_ACTIVATE_SLOW),
   NUM_REPS_ACTIVATE_FAST,    0xFF, VERIFY_SUM8(0x06, 0x06, 0x00, 0x00, 0x00, 0x00, 0x00, 0x00, NUM_FRMS_ACTIVATE_FAST),
   NUM_REPS_ACTIVATE_MED,     0xFF, VERIFY_SUM8(0x0A, 0x0A, 0x00, 0x00, 0x00, 0x00, 0x00, 0x00, NUM_FRMS_ACTIVATE_MED),
   NUM_REPS_DEVELOP_Y1_n_G,   0xFF, VERIFY_SUM8(0x50, 0x28, 0x08, 0x00, 0x00, 0x00, 0x00, 0x00, NUM_FRMS_DEVELOP_Y1_n_G),
   NUM_REPS_DEVELOP_Y2_n_G,   0xFF, VERIFY_SUM8(0x10, 0x00, 0x00, 0x00, 0x00, 0x00, 0x00, 0x00, NUM_FRMS_DEVELOP_Y2_n_G),
   NUM_REPS_LET_IT_SETTLE,    0xFF, VERIFY_SUM8(0x40, 0x10, 0x00, 0x00, 0x00, 0x00, 0x00, 0x00, NUM_FRMS_LET_IT_SETTLE),
};



static const uint8_t __code mLutFastVcom[] = {
   0x04, 0x00, 0x00, 0x11, 0x00, 0x00, 0x00, 0x00, 0x00, 0x00, 0x00,
};

static const uint8_t __code mLutFastB[] = {
   0x04, 0x10, 0x00, 0x00, 0x00, 0x10, 0x01, 0x00, 0x00, 0x00, 0x00, 0x00, 0x00,
};

static const uint8_t __code mLutFastW[] = {
   0x04, 0x20, 0x00, 0x00, 0x00, 0x10, 0x01, 0x00, 0x00, 0x00, 0x00, 0x00, 0x00,
};

static const uint8_t __code mLutFastNoChange[] = {
   0x04, 0x00, 0x00, 0x00, 0x00, 0x10, 0x01, 0x00, 0x00, 0x00, 0x00, 0x00, 0x00,
};

static const uint8_t __code mLutFastXon[] = {

   0x04, 0xff, 0x11, 0x00, 0x00, 0x00, 0x00, 0x00, 0x00, 0x00,
};
#else
#error "Unknown BUILD type"
#endif

#elif defined(ATC1441_LUT)
#if BUILD == chroma74y
static const uint8_t __code  lut20[] = {
   0x01,0x09,0x40,0x32,0x32,0x1C,0x4B,0x34,
   0x00,0x00,0x00,0x01,0x90,0x00,0x32,0x32,0x00,
   0x00,0x00,0x00,0x00,0x00,0x01,0xA5,0x00,0x32,
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   0x00,0x00,0x00,0x00,0x00,0x01,0x05,0x01
};

static const uint8_t __code lut22[] = {
   0x01,0x00,0x11,0x10,0x00,0x32,0x32,0x1C,
   0x4B,0x34,0x00,0x00,0x00,0x01,0x12,0x00,0x00,
   0x00,0x32,0x32,0x00,0x00,0x00,0x00,0x00,0x00,
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   0x01,0x05,0x01
};

static const uint8_t __code lut21[] = {
   0x01,0x00,0x22,0x20,0x00,0x32,0x32,0x1C,
   0x4B,0x34,0x00,0x00,0x00,0x01,0x12,0x00,0x00,
   0x00,0x32,0x32,0x00,0x00,0x00,0x00,0x00,0x00,
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   0x01,0x05,0x01
};

static const uint8_t __code lut25[] = {
   0x01,0x00,0x21,0x20,0x00,0x32,0x32,0x1C,
   0x4B,0x34,0x00,0x00,0x00,0x01,0x12,0x00,0x00,
   0x00,0x32,0x32,0x00,0x00,0x00,0x00,0x00,0x00,
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   0x01,0xC9,0x00
};

static const uint8_t __code lut29[] = {
   0x01,0x3F,0x32,0x32,0x1C,0x4B,0x34,0x00,
   0x00,0x00,0x01,0xFF,0x32,0x32,0x00,0x00,0x00,
   0x00,0x00,0x00,0x01,0xFF,0x32,0x32,0x32,0x32,
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   0x00,0x00,0x00,0x00,0x00,0x00
};
#elif BUILD == chroma74r
uint8_t lut20[] = {
   0x20,0x01,0x00,0x00,0x64,0x64,0x00,0x00,
   0x00,0x00,0x00,0x00,0x01,0x00,0x00,0x01,
   0x01,0x07,0x00,0x00,0x00,0x00,0x00,0x14,
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   0x00,0x00,0x00,0x00,0x00
};

uint8_t lut22[] = {
   0x22,0x01,0x00,0x00,0x00,0x00,0x64,0x64,
   0x00,0x00,0x00,0x00,0x00,0x00,0x01,0x01,
   0x10,0x00,0x00,0x01,0x01,0x07,0x00,0x00,
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   0x00,0x00,0x00,0x00,0x00
};

uint8_t lut21[] = {
   0x21,0x01,0x00,0x00,0x00,0x00,0x64,0x64,
   0x00,0x00,0x00,0x00,0x00,0x00,0x01,0x01,
   0x10,0x00,0x00,0x01,0x01,0x07,0x00,0x00,
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   0x00,0x00,0x00,0x00,0x00
};

uint8_t lut25[] = {
   0x25,0x01,0x00,0x00,0x00,0x00,0x64,0x64,
   0x00,0x00,0x00,0x00,0x00,0x00,0x01,0x00,
   0x20,0x00,0x00,0x01,0x01,0x07,0x00,0x00,
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   0x00,0x00,0x00,0x00,0x00
};

uint8_t lut29[] = {
   0x29,0x01,0x3F,0x64,0x64,0x00,0x00,0x00,
   0x00,0x00,0x00,0x01,0xFF,0x01,0x01,0x07,
   0x00,0x00,0x00,0x00,0x00,0x14,0xFF,0x03,
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   0xFF,0x00,0x00,0x00,0x00,0x00,0x00,0x00,
   0x00
};
#else
#error "Unknown BUILD type"
#endif

struct Atc1441Luts {
   uint8_t Cmd;
   const uint8_t __code *Lut;
   uint16_t LutLen;
} gAtc1441Luts[] = {
   {0x20,lut20,sizeof(lut20)},         // Vcom
   {0x29,lut29,sizeof(lut29)},         // Xon
   {LUT_CMD_000,lut21,sizeof(lut21)},  // black
   {LUT_CMD_001,NULL,260},             // not used
   {LUT_CMD_010,NULL,260},             // not used
   {LUT_CMD_011,NULL,260},             // not used
   {LUT_CMD_100,NULL,260},             // not used
   {LUT_CMD_101,NULL,260},             // not used
   {LUT_CMD_110,lut22,sizeof(lut22)},  // white
   {LUT_CMD_111,lut25,sizeof(lut25)},  // red/yellow
   {0}                                 // End of table
};
#else
#error "Unknown LUT type"
#endif

static const uint8_t __code gPwrUpEpd[] = {
   4,CMD_BOOSTER_SOFT_START,
   0x0e,0xcd,0x26,

   5,CMD_POWER_SETTING,
   0x07,0x00,0x02,0x02,

   1,CMD_POWER_ON,

   0
};

static const uint8_t __code gSetupEpd[] = {
   2,0x65,
   0,

   3,CMD_PANEL_SETTING,
   0x8f,0x80,

   2,CMD_PLL_CONTROL,
   0x3a,

   5,CMD_RESOLUTION_SETTING,
   SCREEN_WIDTH >> 8,SCREEN_WIDTH & 0xff,SCREEN_HEIGHT >> 8,
   SCREEN_HEIGHT & 0xff,

   0
};

static const uint8_t __code gPwrOffEpd[] = {
   1,CMD_POWER_OFF,

   2,CMD_DEEP_SLEEP,
   0xa5,

   0
};


#pragma callee_saves screenPrvSendCommand
static inline void screenPrvSendCommand(uint8_t cmdByte)
{
   screenPrvWaitByteSent();
   P0 &= (uint8_t) ~P0_EPD_D_nCMD;
   __asm__("nop");
   screenByteTx(cmdByte);
   __asm__("nop");
   screenPrvWaitByteSent();
   P0 |= P0_EPD_D_nCMD;
}

#ifdef DMITRY_LUT
static const struct LutCorrectionRange __code corrYellowStageTwoRanges[] = {
   {
      .minTemp = -128,
      .maxTemp = 25,
      .vals = {0x60, 0x18, },
   },
   {
      .minTemp = 26,
      .maxTemp = 127,
      .vals = {0x62, 0x16, },
   },
};

static const struct LutCorrectionEntry __code corrYellowStageTwo[] = {
   [0] = {
      
      //first two durations in DEVELOP_Y2_n_G phase change with temp quite a bit
      
      .offset = 13 * 8 + 5,
      .len = 2,
      .ranges = corrYellowStageTwoRanges,
   },
   [1] = {
      .offset = 0xffff,
   },
};


static const uint8_t __code mLutFastVcom[] = {
   
   0x04, 0x00, 0x00, 0x11, 0x00, 0x00, 0x00, 0x00, 0x00, 0x00, 0x00,
};

static const uint8_t __code mLutFastB[] = {
   0x04, 0x10, 0x00, 0x00, 0x00, 0x10, 0x01, 0x00, 0x00, 0x00, 0x00, 0x00, 0x00,
};

static const uint8_t __code mLutFastW[] = {
   0x04, 0x20, 0x00, 0x00, 0x00, 0x10, 0x01, 0x00, 0x00, 0x00, 0x00, 0x00, 0x00,
};

static const uint8_t __code mLutFastNoChange[] = {
   0x04, 0x00, 0x00, 0x00, 0x00, 0x10, 0x01, 0x00, 0x00, 0x00, 0x00, 0x00, 0x00,
};

static const uint8_t __code mLutFastXon[] = {

   0x04, 0xff, 0x11, 0x00, 0x00, 0x00, 0x00, 0x00, 0x00, 0x00,
};

static void screenPrvSendLut(uint8_t cmd, const uint8_t __code *ptr, uint16_t len, uint16_t sendLen, __bit padWithXonConstant /* else zero */, const struct LutCorrectionEntry __code *corrections) __reentrant
{
   uint8_t __xdata *dst = mScreenRow;
   uint16_t origSendLen = sendLen;
   int8_t CurTemperature = adcSampleTemperature();

   sendLen -= len;
   
   //copy/fill buffer
   xMemCopy(dst, (const void __xdata*)ptr, len);
   dst += len;

   if (padWithXonConstant) {
      
      uint8_t ctr = 0;
      
      while (sendLen--) {
         uint8_t tx = 0;
         
         if (++ctr == 2)
            tx = 0xff;
         else if (ctr == 10)
            ctr = 0;
         *dst++ = tx;
      }
   }
   else
      xMemSet(dst, 0, sendLen);
   
   //apply corrections
   if (corrections) {
      uint16_t ofst;
      
      for (; (ofst = corrections->offset) != 0xffff; corrections++) {
         
         struct LutCorrectionRange __code *rng;
         uint8_t i, len = corrections->len;
         
         //result guaranteed to be found by our range requirements
         for(rng = corrections->ranges; 
             CurTemperature< rng->minTemp || CurTemperature > rng->maxTemp; 
             rng++);
         
         for (i = 0; i < len; i++) {
            mScreenRow[ofst++] = rng->vals[i];
         }
      }
   }
   einkSelect();
   screenPrvSendCommand(cmd);
   dst = mScreenRow;
   while (origSendLen--)
      screenByteTx(*dst++);
   einkDeselect();
}
#endif

void P1INT_ISR(void) __interrupt (15)
{
   SLEEP &= (uint8_t)~(3 << 0);  //wake up
}

// <CommandBytes> <Command> [<Data>] ...]
void SendEpdTbl(uint8_t const __code *pData)
{
   uint8_t CmdBytes;

   while((CmdBytes = *pData++) != 0) {
      einkSelect();
      screenPrvSendCommand(*pData++);
      CmdBytes--;
      while(CmdBytes > 0) {
         screenPrvWaitByteSent();
         U0DBUF = *pData++;
         CmdBytes--;
      }
      einkDeselect();
   }
}

static void screenInitIfNeeded(__bit forPartial)
{
   if(gScreenPowered) {
      return;
   }
   gScreenPowered = true;
   
// Don't select the EPD yet
   P1 |= P1_EPD_nCS0;

// turn on the eInk power (keep in reset for now)
   P0 &= (uint8_t) ~P0_EPD_nENABLE;

// Connect the P1 EPD pins to USART0
   P1SEL |= P1_EPD_SCK | P1_EPD_DI;
   
   U0BAUD = 0;          // F/8 is max for spi - 3.25 MHz
   U0GCR = 0b00110001;  // BAUD_E = 0x11, msb first
   U0CSR = 0b00000000;  // SPI master mode, RX off
   
   timerDelay(TIMER_TICKS_PER_SECOND * 10 / 1000); //wait 10ms
   
// release reset
   P1 |= P1_EPD_nRESET;
   timerDelay(TIMER_TICKS_PER_SECOND * 10 / 1000); //wait 10ms
   
// wait for not busy
   while(!EPD_BUSY());
   
// we can now talk to it
   SendEpdTbl(gPwrUpEpd);
   
// wait for not busy
   while(!EPD_BUSY());
   
   SendEpdTbl(gSetupEpd);

   einkSelect();
   screenPrvSendCommand(CMD_VCOM_DC_SETTING);
   screenByteTx(mScreenVcom);
   einkDeselect();
   
   einkSelect();
   screenPrvSendCommand(CMD_VCOM_INTERVAL);
   screenByteTx(forPartial ? 0xf7 : 0x77);
   einkDeselect();
   
#ifdef DMITRY_LUT
   if (forPartial) { //partial-fast LUTs. be cautious to not over-DC the screen
      SET_LUT(0x20, mLutFastVcom, 220, 0);
      SET_XON_LUT(mLutFastXon);
      SET_COLOR_LUT(000, mLutFastB, 0);
      SET_COLOR_LUT(001, mLutFastW, 0);
      SET_COLOR_LUT(010, mLutFastNoChange, 0);
      SET_COLOR_LUT(011, mLutFastNoChange, 0);
      SET_COLOR_LUT(100, mLutFastNoChange, 0);
      SET_COLOR_LUT(101, mLutFastNoChange, 0);
      SET_COLOR_LUT(110, mLutFastNoChange, 0);
      SET_COLOR_LUT(111, mLutFastNoChange, 0);
   }
   else {            //full refersh LUTs
      SET_LUT(0x20, mLutVcom, 220, 0);
      SET_XON_LUT(mLutXon);
      SET_COLOR_LUT(000, mLutB, 0);
      SET_COLOR_LUT(001, mLutG0, 0);
      SET_COLOR_LUT(010, mLutG1, 0);
      SET_COLOR_LUT(011, mLutG2, 0);
      SET_COLOR_LUT(100, mLutG3, 0);
      SET_COLOR_LUT(101, mLutG4, 0);
      SET_COLOR_LUT(110, mLutW, 0);
      SET_COLOR_LUT(111, mLutBrightYellow, corrYellowStageTwo);
   }
#endif
#ifdef ATC1441_LUT
   int8_t i;
   int16_t j;
   for(i = 0; gAtc1441Luts[i].Cmd != 0; i++) {
      einkSelect();
      screenPrvSendCommand(gAtc1441Luts[i].Cmd);
      for(j = 0; j < gAtc1441Luts[i].LutLen; j++) {
         if(gAtc1441Luts[i].Lut == NULL) {
         // Empty table
            screenByteTx(0);
         }
         else {
            screenByteTx(gAtc1441Luts[i].Lut[j]);
         }
      }
      einkDeselect();
   }
#endif
   LOG_CONFIG("screenInitIfNeeded");
}

void screenShutdown(void)
{
   if (!gScreenPowered) {
      return;
   }
   
   SendEpdTbl(gPwrOffEpd);

// Reconfigure the EPD SPI pins as GPIO
// Disconnect the P1 EPD SPI pins from USART0 and connect them to GPIO
   P1SEL &= ~(P1_EPD_SCK | P1_EPD_DI);

// Drive all of the control pins LOW to avoid back powering the EPD via the 
// control pins

   P0 &= ~(P0_EPD_BS1 | P0_EPD_nCS1 | P0_EPD_D_nCMD);
   P1 &= ~(P1_EPD_nCS0 | P1_EPD_nRESET | P1_EPD_SCK | P1_EPD_DI);
// Turn off power to the EPD
   SET_EPD_nENABLE(1);
   
   gScreenPowered = false;

   LOG_CONFIG("screenShutdown");
}

void screenTxStart(__bit forPartial)
{
   screenInitIfNeeded(forPartial);
   
   einkSelect();
   screenPrvSendCommand(CMD_DISPLAY_START_TRANSMISSION_DTM1);
}

#pragma callee_saves screenByteTx
void screenByteTx(uint8_t byte)
{
   screenPrvWaitByteSent();
   U0DBUF = byte;
}

void drawWithSleep() 
{
#ifdef DISABLE_DISPLAY
   LOGA("NOT updating display\n");
#else
   uint16_t Lowest = 0xffff;

   LOGA("Updating display\n");
   einkDeselect();
   einkSelect();
   screenPrvSendCommand(CMD_DISPLAY_REFRESH);
   einkDeselect();
   
   while(!EPD_BUSY()) {
   // Wake up every 50 milliseconds to check BattV and EPD_BUSY
      sleepForMsec(50UL);
      clockingAndIntsInit();  // restart clocks
      ADCRead(ADC_CHAN_VDD_3);
      if(Lowest > gRawA2DValue) {
         Lowest = gRawA2DValue;
      }
   }
   gRefreshBattV = ADCScaleVDD(Lowest);
   powerUp(INIT_BASE);
   screenShutdown();
   UpdateVBatt();
   LOGA("Update complete\n");
#endif
}

